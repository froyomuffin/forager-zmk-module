## boards/shields/forager/Kconfig.defconfig
```kconfig
if SHIELD_FORAGER_DONGLE

config ZMK_KEYBOARD_NAME
    default "Forager"

config ZMK_SPLIT_ROLE_CENTRAL
    default y

config ZMK_STUDIO
    default n

endif

if SHIELD_FORAGER_LEFT

config ZMK_KEYBOARD_NAME
    default "Forager Left"

endif

if SHIELD_FORAGER_RIGHT

config ZMK_KEYBOARD_NAME
    default "Forager Right"

endif

if SHIELD_FORAGER_LEFT || SHIELD_FORAGER_RIGHT || SHIELD_FORAGER_DONGLE

config ZMK_SPLIT
    default y

endif
```
